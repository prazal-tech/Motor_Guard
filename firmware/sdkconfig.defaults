## firmware/sdkconfig.defaults
```kconfig
# ESP-IDF Motor Guard sdkconfig defaults
CONFIG_IDF_TARGET="esp32"
CONFIG_ESP_MAIN_TASK_STACK_SIZE=4096
CONFIG_HTTPD_MAX_REQ_HDR_LEN=1024
CONFIG_HTTPD_MAX_URI_LEN=512
CONFIG_HTTPD_PURGE_BUF_LEN=32
CONFIG_FREERTOS_HZ=1000
```
